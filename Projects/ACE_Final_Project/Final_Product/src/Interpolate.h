#include <Arduino.h>
#include <iostream>
#include <cmath>

#define MAX_VALUE_INTERPOLATED 950

// Round float
float roundFloat(float number, int decimalPlaces) {
    // Calculate the multiplier to shift the decimal places
    float multiplier = std::pow(10.0, decimalPlaces);

    // Round the number to the specified decimal places
    float roundedNumber = std::round(number * multiplier) / multiplier;

    return roundedNumber;
}

// Distance values
float d[MAX_VALUE_INTERPOLATED] = {
    8.00,  8.01,  
    8.02,  8.03,  8.04,  8.05,  8.06,  8.07,  8.08,  8.09,  8.10,  8.11,
    8.12,  8.13,  8.14,  8.15,  8.16,  8.17,  8.18,  8.19,  8.20,  8.21,
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    17.42,  17.43,  17.44,  17.45,  17.46,  17.47,  17.48,  17.49,
    };

// Servo 3 interpolated values
float o3[MAX_VALUE_INTERPOLATED] = {
  100.50,  100.57,  
  100.64,  100.71,  100.78,  100.85,  100.92,  100.99,  101.06,  101.13,  101.20,  101.27,  
  101.34,  101.41,  101.48,  101.55,  101.62,  101.69,  101.76,  101.83,  101.90,  101.97,  
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  149.20,  149.30,  149.40,  149.50,  149.60,  149.70,  149.80,  149.90
};

// Servo 4 interpolated values
float o4[MAX_VALUE_INTERPOLATED] = {
  42.50,  42.51,  
  42.52,  42.53,  42.54,  42.55,  42.56,  42.57,  42.58,  42.59,  42.60,  42.61,  
  42.62,  42.63,  42.64,  42.65,  42.66,  42.67,  42.68,  42.69,  42.70,  42.71,  
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  127.04,  127.16,  127.28,  127.40,  127.52,  127.64,  127.76,  127.88
};

// Function to perform binary search
int binarySearch(float x, float* arr, int size) {
  int low = 0;
  int high = size - 1;

  while (low <= high) {
    int mid = low + (high - low) / 2;

    if (arr[mid] == x) {
      return mid; // Found exact match
    } else if (arr[mid] < x) {
      low = mid + 1;
    } else {
      high = mid - 1;
    }
  }

  return -1; // Not found
}

// Function to lookup a value in the table
int lookupValue(float x, float* tableX, float* tableY, int size) {
  
  x = roundFloat(x, 2);
  
  if (x >= 17.00)
    x = 17.00;

  if ( x <= 7.5){
    x = 7.50;
  } 

  int index = binarySearch(x, tableX, size);
  if (index != -1) {
    return tableY[index];
  }
  // Handle the case where x is not found in the table
  return 0;  // You can choose a default value or handle it differently
}

// S3 angle according to distance
float getS3Interpolated(float distance){
    // Lookup the value
    return lookupValue(distance, d, o3, MAX_VALUE_INTERPOLATED);
}

// S4 angle according to distance
float getS4Interpolated(float distance){
    // Lookup the value
    return lookupValue(distance, d, o4, MAX_VALUE_INTERPOLATED);
}

